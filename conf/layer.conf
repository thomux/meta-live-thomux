## conf/layer.conf
```bitbake
# We have a conf and classes directory, add to BBPATH
BBPATH .= ":${LAYERDIR}"

# We have recipes-* directories, add to BBFILES
BBFILES += "${LAYERDIR}/recipes-*/*/*.bb \
            ${LAYERDIR}/recipes-*/*/*.bbappend"

BBFILE_COLLECTIONS += "meta-live-thomux"
BBFILE_PATTERN_meta-live-thomux = "^${LAYERDIR}/"
BBFILE_PRIORITY_meta-live-thomux = "6"

LAYERDEPENDS_meta-live-thomux = "core"
LAYERSERIES_COMPAT_meta-live-thomux = "dunfell"
```
